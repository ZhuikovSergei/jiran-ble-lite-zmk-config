## config/west.yml
```yaml
manifest:
  remotes:
    - name: zmkfirmware
      url-base: https://github.com/zmkfirmware
  projects:
    - name: zmk
      remote: zmkfirmware
      revision: c1ebadcd2a1b7cad47c2224a4fb6130cda80b7e3
      import: app/west.yml
  self:
    path: config
```
